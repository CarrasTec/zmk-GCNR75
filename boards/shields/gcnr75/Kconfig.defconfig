## boards/shields/gcnr75/Kconfig.defconfig
```kconfig
if SHIELD_GCNR75_LEFT

# Name must be less than 16 characters long!
config ZMK_KEYBOARD_NAME
    default "GCNR75"

config ZMK_SPLIT_ROLE_CENTRAL
    default y

config ZMK_STUDIO
    default y

endif

if SHIELD_GCNR75_LEFT || SHIELD_GCNR75_RIGHT

config ZMK_SPLIT
    default y

endif

if SHIELD_GCNR75_RIGHT

config EC11
    default y

config EC11_TRIGGER_GLOBAL_THREAD
    default y

endif
```

## boards/shields/gcnr75/Kconfig.shield
```kconfig
# No whitespace after the comma or in your part name!
config SHIELD_GCNR75_LEFT
    def_bool $(shields_list_contains,gcnr75_left)

# No whitespace after the comma or in your part name!
config SHIELD_GCNR75_RIGHT
    def_bool $(shields_list_contains,gcnr75_right)
```
